## hermit-at-3.8.0/Kconfig
```kconfig
#
# Kconfig
#

mainmenu "Hermit-at Configuration"

source "src/target/Kconfig"

source "src/host/Kconfig"
```

## hermit-at-3.8.0/src/host/Kconfig
```kconfig
#
# src/host/Kconfig
#

comment "HOST"

config HOST_BUILD
	bool "build an application for hosts"

menu "Host Configurations"
	depends on HOST_BUILD

config HOST_FUNC_FIRMUPDATE
	bool "firmupdate function support"
	default y
	help
	  if you want to support Armadillo-J firmware update command

endmenu
```

## hermit-at-3.8.0/src/target/Kconfig
```kconfig
#
# src/target/Kconfig
#

comment "TARGET"

config TARGET_BUILD
	bool "build a bootloader image for your board"

menu "Target System Type"
	depends on TARGET_BUILD

choice
	prompt "Platform type"
	default PLATFORM_ARMADILLO9

config PLATFORM_ARMADILLO9
	bool "Armadillo-9"
	select CPU_EP93XX
	select HAS_FLASH
	select HAS_ETHERNET
	select HAS_COMPACTFLASH

config PLATFORM_ARMADILLO2X0
	bool "Armadillo-2x0"
	select CPU_EP93XX
	select HAS_FLASH
	select HAS_ETHERNET

config PLATFORM_ARMADILLO3X0
	bool "Armadillo-3x0"
	select CPU_NS9750
	select HAS_FLASH
	select HAS_ETHERNET
	select HAS_COMPACTFLASH

config MACHINE_ARMADILLO4X0
	bool "Armadillo-4x0"
	select PLATFORM_ARMADILLO4X0
	select CPU_IMX25
	select HAS_FLASH
	select HAS_ETHERNET
	select HAS_MMCSD

config MACHINE_ARMADILLO_BOX_WS1
	bool "Armadillo-Box WS1"
	select PLATFORM_ARMADILLO4X0
	select CPU_IMX25
	select HAS_FLASH
	select HAS_ETHERNET
	select HAS_MMCSD

config PLATFORM_ARMADILLO_IOTG_STD
	bool "Armadillo-IoT Gateway Standard"
	select CPU_IMX25
	select HAS_FLASH
	select HAS_ETHERNET
	select HAS_MMCSD
	select GPIO_PCA9538

config PLATFORM_ARMADILLO5X0
	bool "Armadillo-5x0"
	select CPU_IMX31
	select HAS_FLASH
	select HAS_ETHERNET
	select HAS_COMPACTFLASH
	select HAS_MMCSD
	select ARMADILLO500_DEV_WORKAROUND_A500_ERRATUM_7

config PLATFORM_ARMADILLO800EVA
	bool "Armadillo-800 EVA"
	select PLATFORM_ARMADILLO8X0
	select CPU_RMA1
	select HAS_FLASH
	select HAS_ETHERNET
	select HAS_MMCSD
	select I2C_RMA1

config PLATFORM_ARMADILLO810
	bool "Armadillo-810"
	select PLATFORM_ARMADILLO8X0
	select CPU_RMA1
	select HAS_FLASH
	select HAS_MMCSD
	select I2C_RMA1
	select FS_SQUASH
	select CROSSDEV_ARMHF

config PLATFORM_ARMADILLO840
	bool "Armadillo-840"
	select PLATFORM_ARMADILLO8X0
	select CPU_RMA1
	select HAS_FLASH
	select HAS_ETHERNET
	select HAS_MMCSD
	select I2C_RMA1
	select FS_SQUASH
	select CROSSDEV_ARMHF

config PLATFORM_SUZAKU
	bool "Suzaku"
	select HAS_FLASH

endchoice

config PLATFORM_ARMADILLO4X0
	bool
config MACH_NAME
	string
	default "armadillo4x0" if MACHINE_ARMADILLO4X0
	default "armadillo-box-ws1" if MACHINE_ARMADILLO_BOX_WS1

config PLATFORM_ARMADILLO8X0
	bool
config MACH_NAME
	string
	default "armadillo800eva" if PLATFORM_ARMADILLO800EVA
	default "armadillo810" if PLATFORM_ARMADILLO810
	default "armadillo840" if PLATFORM_ARMADILLO840

config PLATFORM_NAME
	string
	default "armadillo9" if PLATFORM_ARMADILLO9
	default "armadillo2x0" if PLATFORM_ARMADILLO2X0
	default "armadillo3x0" if PLATFORM_ARMADILLO3X0
	default "armadillo-box-ws1" if MACHINE_ARMADILLO_BOX_WS1
	default "armadillo4x0" if PLATFORM_ARMADILLO4X0
	default "armadillo-iotg-std" if PLATFORM_ARMADILLO_IOTG_STD
	default "armadillo5x0" if PLATFORM_ARMADILLO5X0
	default "armadillo8x0" if PLATFORM_ARMADILLO8X0
	default "suzaku" if PLATFORM_SUZAKU

config PLATFORM_ARCH_NAME
	string
	default "ep93xx" if PLATFORM_ARMADILLO9 || PLATFORM_ARMADILLO2X0
	default "ns9750" if PLATFORM_ARMADILLO3X0
	default "mx25" if PLATFORM_ARMADILLO4X0 || PLATFORM_ARMADILLO_IOTG_STD
	default "mx3" if PLATFORM_ARMADILLO5X0
	default "rma1" if PLATFORM_ARMADILLO8X0
	default "microblaze" if PLATFORM_SUZAKU_S
	default "powerpc" if PLATFORM_SUZAKU_V

source "src/target/armadillo9/Kconfig"
source "src/target/armadillo2x0/Kconfig"
source "src/target/armadillo3x0/Kconfig"
source "src/target/armadillo4x0/Kconfig"
source "src/target/armadillo-iotg-std/Kconfig"
source "src/target/armadillo5x0/Kconfig"
source "src/target/suzaku/Kconfig"

config PROFILE_NAME
	string "Profile name"
	default ""

config CPU_EP93XX
	bool
	select ARCH_ARM
	select ARCH_ARM_920T
	select HAS_MMU

config CPU_NS9750
	bool
	select ARCH_ARM
	select ARCH_ARM_926T
	select HAS_MMU

config CPU_IMX25
	bool
	select ARCH_ARM
	select ARCH_ARM_926T
	select HAS_MMU
	select HAS_WDT

config CPU_IMX31
	bool
	select ARCH_ARM
	select ARCH_ARM_V6
	select HAS_MMU

config CPU_RMA1
	bool
	select ARCH_ARM
	select ARCH_ARM_V7
	select HAS_MMU
	select HAS_WDT

config ARCH_ARM
	bool
config ARCH_ARM_920T
	bool
	select ARCH_ARM_32v4T
config ARCH_ARM_926T
	bool
	select ARCH_ARM_32v5
config ARCH_ARM_V6
	bool
	select ARCH_ARM_32v6
config ARCH_ARM_V7
	bool
	select ARCH_ARM_32v7
config ARCH_ARM_32v4T
       bool
config ARCH_ARM_32v5
       bool
config ARCH_ARM_32v6
       bool
config ARCH_ARM_32v7
       bool

config ARCH_MICROBLAZE
	bool
	select HAS_CACHE

config ARCH_PPC
	bool
	select HAS_CACHE

config HAS_CACHE
	bool
config HAS_MMU
	bool
config HAS_WDT
	bool
config HAS_FLASH
	bool
config HAS_ETHERNET
	bool
config HAS_MMCSD
	bool
config HAS_COMPACTFLASH
	bool

config CROSSDEV_ARMHF
	bool

endmenu # Target settings #

menu "Target Configurations"
	depends on TARGET_BUILD

#comment "General setup"

config SYSTEM_EXPERIMENTAL
	bool "prompt for experimental options"

config SYSTEM_DEBUGGING
	bool "prompt for debugging options"

source "src/target/core/Kconfig"
source "src/target/driver/Kconfig"
source "src/target/command/Kconfig"

endmenu
```

## hermit-at-3.8.0/src/target/armadillo5x0/Kconfig
```kconfig
#
# src/target/armadillo5x0/Kconfig
#

if PLATFORM_ARMADILLO5X0

choice
	prompt "Base-board type"
	default PLATFORM_ARMADILLO500_DEV

config PLATFORM_ARMADILLO500_DEV
	bool "Development Board"
	select HAS_BASE_BOARD_ID
	select CMD_BOOT

config PLATFORM_ARMADILLO500_FX
	bool "FX Board"
	select CMD_BOOT

config PLATFORM_ARMADILLO500_ZERO
	bool "Any Board"

endchoice

config HAS_BASE_BOARD_ID
	bool

choice
	prompt "Default CPU clock"
	default PLATFORM_DEFCLOCK_IS_AUTODETECT

config PLATFORM_DEFCLOCK_IS_AUTODETECT
	bool "AutoDetect"

config PLATFORM_DEFCLOCK_IS_400MHz
	bool "400MHz"

config PLATFORM_DEFCLOCK_IS_532MHZ
	bool "532MHz"

endchoice

config PLATFORM_DEFCLOCK
	string
	default "auto" if PLATFORM_DEFCLOCK_IS_AUTODETECT
	default "400" if PLATFORM_DEFCLOCK_IS_400MHz
	default "532" if PLATFORM_DEFCLOCK_IS_532MHZ

config ARMADILLO500_DEV_WORKAROUND_A500_ERRATUM_7
       bool "workaround for a500 erratum #7"
       depends on PLATFORM_ARMADILLO5X0
       default y

endif # PLATFORM_ARMADILLO5X0
```

## hermit-at-3.8.0/src/target/command/Kconfig
```kconfig
#
# src/target/command/Kconfig
#

menu "Commands"

comment "Standard Commands"

config CMD_BOOT
	bool "boot/linux"
	default y

config CMD_DOWNLOAD
	bool "download"
	default y
	select CMD_MEMMAP

config CMD_FROB
	bool "frob"
	default y

config CMD_HELP
	bool "help"
	default y

config CMD_JUMP
	bool "jump"

config CMD_MEDIUM
	bool "medium"
	default y

config CMD_MEMMAP
	bool "memmap"
	default y

config CMD_UPLOAD
	bool "upload"

config CMD_VERSION
	bool "version"
	default y

comment "Optional Commands"

config CMD_INFO
	bool "info"

config CMD_MAC
	bool "mac"
	depends on ETHERNET

config CMD_MAP
	bool "map"
	depends on SYSTEM_DEBUGGING

config CMD_MD5SUM
	bool "md5sum"

config CMD_PASSWD
	bool "passwd"
	select CMD_SETPARAM

config CMD_SETBOOTDEVICE
	bool "setbootdevice"
	select CMD_SETPARAM

config CMD_SETBOOTDEVICE_DEFAULT_DEVICE
	string "Default Device"
	depends on CMD_SETBOOTDEVICE

config CMD_SETBOOTDEVICE_FLASH
	bool "\"flash\" support"
	depends on CMD_SETBOOTDEVICE && FLASH
	default y

config CMD_SETBOOTDEVICE_HD
	bool "\"hd[abcd]\" support"
	depends on CMD_SETBOOTDEVICE && COMPACTFLASH

config CMD_SETBOOTDEVICE_MMCSD
	bool "\"mmcblk\" support"
	depends on CMD_SETBOOTDEVICE && MMCSD

config CMD_SETBOOTDEVICE_TFTP
	bool "\"tftp\" support"
	depends on CMD_SETBOOTDEVICE && CMD_TFTPBOOT

config CMD_SETCLOCK
	bool "setclock"
	depends on PLATFORM_ARMADILLO5X0
	select CMD_SETPARAM

config CMD_SETENV
	bool "setenv/clearenv"
	select CMD_SETPARAM

config CMD_SETPARAM
	bool

config CMD_TFTPBOOT
	bool "tftpboot"
	depends on ETHERNET
	select NET_UDP_TFTP

config CMD_TFTPDL
	bool "tftpdl"
	depends on ETHERNET
	select NET_UDP_TFTP

comment "Optional Functions"

config FUNC_DHCPC
	bool "Support for DHCP Client"
	depends on ETHERNET && (CMD_TFTPBOOT || CMD_TFTPDL)

endmenu
```

## hermit-at-3.8.0/src/target/core/Kconfig
```kconfig
#
# src/target/core/Kconfig
#

menu "Core settings"

choice
	prompt "entry-point selection"
	default SYSTEM_ENTRYPOINT_FLASH

config SYSTEM_ENTRYPOINT_FLASH
	bool "flash"
	select SYSTEM_NEED_RELOCATE

config SYSTEM_ENTRYPOINT_RAM
	bool "ram"
	depends on !CPU_RMA1

config SYSTEM_ENTRYPOINT_SRAM
	bool "sram"
	select SYSTEM_NEED_RELOCATE
	depends on CPU_RMA1

endchoice

config SYSTEM_LDSCRIPT
	string
	default "flash" if SYSTEM_ENTRYPOINT_FLASH
	default "ram" if SYSTEM_ENTRYPOINT_RAM
	default "sram" if SYSTEM_ENTRYPOINT_SRAM

config SYSTEM_NEED_RELOCATE
	bool

choice
	prompt "region to load image selection"

config SYSTEM_BOOT_REGION_KERNEL
	bool "kernel/userland"

config SYSTEM_BOOT_REGION_IMAGE
	bool "image"

endchoice

choice
	prompt "\"mtdparts\" assign method"
	default MTDPARTS_AUTO

config MTDPARTS_FIXED
	bool "fixed"

config MTDPARTS_AUTO
	bool "auto"

endchoice

config FIXED_MTDPARTS_STRINGS
	string "default MTDPARTS"
	depends on MTDPARTS_FIXED

config AUTOBOOT
	bool "Support for Autoboot"
	default y
	select CMD_BOOT

config AUTOBOOT_CANCEL_BY_TACTSW
	bool "Support for Autoboot cancel by Tact-SW"
	depends on AUTOBOOT && (PLATFORM_ARMADILLO2X0 || PLATFORM_ARMADILLO4X0 || PLATFORM_ARMADILLO_IOTG_STD)
	default n if PLATFORM_ARMADILLO2X0
	default y if (PLATFORM_ARMADILLO4X0 || PLATFORM_ARMADILLO_IOTG_STD)

config COMPATIBLE_MEDIA_BOOT
	bool "Support for compatible media boot"
	depends on (PLATFORM_ARMADILLO9 || PLATFORM_ARMADILLO3X0)

config PASSWD_LOCK
	bool "Support for password lock"
	select CMD_PASSWD

endmenu
```
