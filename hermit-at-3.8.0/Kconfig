## hermit-at-3.8.0/src/target/driver/Kconfig
```kconfig
#
# src/target/driver/Kconfig
#

menu "Support Devices"

#
# Console
#
choice
	prompt "Console"
	default CONSOLE_TTYAM0 if (CPU_EP93XX || CPU_NS9750)
	default CONSOLE_TTYMXC0 if CPU_IMX31
	default CONSOLE_TTYMXC1 if PLATFORM_ARMADILLO4X0 || PLATFORM_ARMADILLO_IOTG_STD
	default CONSOLE_TTYSC1 if PLATFORM_ARMADILLO800EVA
	default CONSOLE_TTYSC2 if (PLATFORM_ARMADILLO810 || PLATFORM_ARMADILLO840)
	default CONSOLE_TTYS0 if PLATFORM_SUZAKU

config CONSOLE_TTYAM0
	bool "ttyAM0"
	depends on CPU_EP93XX || CPU_NS9750
config CONSOLE_TTYAM1
	bool "ttyAM1"
	depends on CPU_EP93XX || CPU_NS9750
config CONSOLE_TTYAM2
	bool "ttyAM2"
	depends on CPU_EP93XX
config CONSOLE_TTYMXC0
	bool "ttymxc0"
	depends on (CPU_IMX31 || (CPU_IMX25 && PLATFORM_ARMADILLO_IOTG_STD))
config CONSOLE_TTYMXC1
	bool "ttymxc1"
	depends on (CPU_IMX25 && (PLATFORM_ARMADILLO4X0 || PLATFORM_ARMADILLO_IOTG_STD)) || CPU_IMX31
config CONSOLE_TTYMXC2
	bool "ttymxc2"
	depends on (CPU_IMX25 && PLATFORM_ARMADILLO4X0 && ! MACHINE_ARMADILLO_BOX_WS1)
config CONSOLE_TTYMXC3
	bool "ttymxc3"
	depends on (CPU_IMX25 && ((PLATFORM_ARMADILLO4X0 && ! MACHINE_ARMADILLO_BOX_WS1) || PLATFORM_ARMADILLO_IOTG_STD))
config CONSOLE_TTYMXC4
	bool "ttymxc4"
	depends on (CPU_IMX25 && ((PLATFORM_ARMADILLO4X0 && ! MACHINE_ARMADILLO_BOX_WS1) || PLATFORM_ARMADILLO_IOTG_STD)) || (CPU_IMX31 && PLATFORM_ARMADILLO500_FX)
config CONSOLE_TTYS0
	bool "ttyS0"
	depends on PLATFORM_SUZAKU
config CONSOLE_TTYSC1
	bool "ttySC1"
	depends on PLATFORM_ARMADILLO800EVA
config CONSOLE_TTYSC2
	bool "ttySC2"
	depends on (PLATFORM_ARMADILLO810 || PLATFORM_ARMADILLO840)

config CONSOLE_NONE
	bool "none"

endchoice

config DEFAULT_CONSOLE
	string
	default "ttyAM0" if CONSOLE_TTYAM0
	default "ttyAM1" if CONSOLE_TTYAM1
	default "ttyAM2" if CONSOLE_TTYAM2
	default "ttymxc0" if CONSOLE_TTYMXC0
	default "ttymxc1" if CONSOLE_TTYMXC1
	default "ttymxc2" if CONSOLE_TTYMXC2
	default "ttymxc3" if CONSOLE_TTYMXC3
	default "ttymxc4" if CONSOLE_TTYMXC4
	default "ttyS0" if CONSOLE_TTYS0
	default "ttySC1" if CONSOLE_TTYSC1
	default "ttySC2" if CONSOLE_TTYSC2
	default "none" if CONSOLE_NONE

config STANDARD_CONSOLE
	string
	default "ttyAM0" if (CPU_EP93XX || CPU_NS9750)
	default "ttymxc0" if CPU_IMX31
	default "ttymxc1" if (CPU_IMX25 && (PLATFORM_ARMADILLO4X0 || PLATFORM_ARMADILLO_IOTG_STD))
	default "ttyS0" if PLATFORM_SUZAKU
	default "ttySC1" if PLATFORM_ARMADILLO800EVA
	default "ttySC2" if (PLATFORM_ARMADILLO810 || PLATFORM_ARMADILLO840)

config TTYMXC1_DTR_DSR_DCD_RI_MX25
	bool "Support for ttymxc1 DTR/DSR/DCD/RI"
	depends on CONSOLE_TTYMXC1 && PLATFORM_ARMADILLO4X0

#
# Flash Memory
#
config FLASH
	bool "Flash memory support"
	depends on HAS_FLASH

config FLASH_AMD
	bool "Support for AMD/Fujitsu chips"
	depends on FLASH

config FLASH_INTEL
	bool "Support for Intel/Sharp chips"
	depends on FLASH

config FLASH_SPI
	bool "Support for SPI chips"
	depends on FLASH

choice
	prompt "Device"
	depends on FLASH_SPI
	default FLASH_SPI_M25P64

config FLASH_SPI_M25P64
	bool "M25P64"

endchoice

#
# Ethernet
#
config ETHERNET
	bool "Ethernet support"
	depends on HAS_ETHERNET
	select NET_CORE

config ETHERNET_DEBUG
	bool "Debugging Ethernet"
	depends on ETHERNET && SYSTEM_DEBUGGING

config ETHERNET_EP93XX
	bool "Support for EP93xx Ethernet Controller"
	depends on ETHERNET && CPU_EP93XX
	select I2C_EP93XX_GPIO

config ETHERNET_MX25_FEC
	bool "Support for i.MX25 Fast Ethernet Controller (FEC)"
	depends on ETHERNET && (PLATFORM_ARMADILLO4X0 || PLATFORM_ARMADILLO_IOTG_STD)
	select I2C_MX25

config ETHERNET_NS9750
	bool "Support for NS9750 Ethernet Controller"
	depends on ETHERNET && CPU_NS9750
	select I2C_NS9750

config ETHERNET_SMSC911X
	bool "Support for SMSC LAN911X Ethernet Controller"
	depends on ETHERNET && PLATFORM_ARMADILLO5X0

config ETHERNET_RMA1
	bool "Support for R-Mobile A1 Ethernet Controller"
	depends on ETHERNET && PLATFORM_ARMADILLO8X0
	select I2C_RMA1

config NET_CORE
	bool
config NET_UDP
	bool
config NET_UDP_TFTP
	bool
	select NET_UDP
config NET_TCP
	bool
config NET_TCP_HTTP
	bool
	select NET_TCP

#
# I2C
#
config I2C_EP93XX_GPIO
	bool

config I2C_MX25
	bool

config I2C_NS9750
	bool

config I2C_RMA1
	bool

config I2C_MX25_GPIO
	bool

#
# MMC/SD
#
config MMCSD
	bool "MMC/SD support"
	depends on HAS_MMCSD
	select GENDISK

config MMCSD_DEBUG
	bool "Debugging MMC/SD"
	depends on MMCSD && SYSTEM_DEBUGGING

config MMCSD_MX25_ESDHC
	bool "Support for i.MX25 Secured Digital Host Controller (eSDHC)"
	depends on MMCSD && CPU_IMX25

config MMCSD_MX25_ESDHC2
	bool "Support for i.MX25 Secured Digital Host Controller 2 (eSDHC2)"
	depends on MMCSD && CPU_IMX25 && MMCSD_MX25_ESDHC

config MMCSD_MX31_SDHC
	bool "Support for i.MX31 Secured Digital Host Controller (SDHC)"
	depends on MMCSD && CPU_IMX31

config MMCSD_RMA1_MMC
	bool "Support for RMA1 Multi Media Card Interface (MMCIF)"
	depends on MMCSD && CPU_RMA1
	select MMCSD_RMA1_CORE

config MMCSD_RMA1_SDHC
	bool "Support for RMA1 Secured Digital Host Interface (SDHI)"
	depends on MMCSD && CPU_RMA1
	select MMCSD_RMA1_CORE

config MMCSD_RMA1_CORE
	bool
	depends on MMCSD && CPU_RMA1

#
# Compact Flash
#
config COMPACTFLASH
	bool "Compact Flash support"
	depends on HAS_COMPACTFLASH
	select IDE_CORE

config COMPACTFLASH_DEBUG
	bool "Debugging Compact Flash"
	depends on COMPACTFLASH && SYSTEM_DEBUGGING

config COMPACTFLASH_EP93XX
	bool "Support for EP93xx Compact Flash & IDE"
	depends on COMPACTFLASH && PLATFORM_ARMADILLO9
	select PCMCIA_CORE

config COMPACTFLASH_A3X0
	bool "Support for Armadillo-3x0 Compact Flash"
	depends on COMPACTFLASH && PLATFORM_ARMADILLO3X0

config COMPACTFLASH_MX31
	bool "Support for i.MX31 Comapct Flash"
	depends on COMPACTFLASH && PLATFORM_ARMADILLO5X0
	select PCMCIA_CORE

config PCMCIA_CORE
	bool
config IDE_CORE
	bool
	select GENDISK
config GENDISK
	bool
	select FS_EXT2

#
# File System
#
config FS_EXT2
	bool

config FS_SQUASH
	bool

#
# Watchdog Timer
#
config WDT
	bool "Watchdog support"
        depends on HAS_WDT

config WDT_MX25
	bool "Support for i.MX25 Watchdog Timer (WDOG)"
	depends on WDT && (PLATFORM_ARMADILLO4X0 || PLATFORM_ARMADILLO_IOTG_STD)
	select IRQ_MX25

config WDT_RMA1
	bool "Support for RMA1 Watchdog Timer (RWDT)"
	depends on WDT && PLATFORM_ARMADILLO8X0
	select IRQ_RMA1

config IRQ
	bool
config IRQ_MX25
	bool
	select IRQ
config IRQ_RMA1
	bool
	select IRQ

#
# CryptoMemory
#
config EEPROM_AT88SC
	bool "Support for Atmel AT88SC (CryptoMemory)"
        depends on (PLATFORM_ARMADILLO810 || PLATFORM_ARMADILLO840)

#
# GPIO Expander
#
config GPIO_PCA9538
	bool "Support for NXP PCA9538A"
	depends on PLATFORM_ARMADILLO_IOTG_STD
	select I2C_MX25_GPIO

endmenu
```

## hermit-at-3.8.0/src/target/suzaku/Kconfig
```kconfig
#
# src/target/suzaku/Kconfig
#

if PLATFORM_SUZAKU

choice
	prompt "Board type"
	default PLATFORM_SUZAKU_S

config PLATFORM_SUZAKU_S
	bool "SUZAKU-S"
	select ARCH_MICROBLAZE

config PLATFORM_SUZAKU_V
	bool "SUZAKU-V"
	select ARCH_PPC

endchoice

endif
```

## linux-3.14-at4/arch/arm/configs/armadillo4x0_defconfig
```kconfig
CONFIG_SYSVIPC=y
CONFIG_POSIX_MQUEUE=y
CONFIG_AUDIT=y
CONFIG_AUDITSYSCALL=y
CONFIG_NO_HZ=y
CONFIG_HIGH_RES_TIMERS=y
CONFIG_BSD_PROCESS_ACCT=y
CONFIG_TASKSTATS=y
CONFIG_TASK_DELAY_ACCT=y
CONFIG_TASK_XACCT=y
CONFIG_TASK_IO_ACCOUNTING=y
CONFIG_IKCONFIG=y
CONFIG_IKCONFIG_PROC=y
CONFIG_LOG_BUF_SHIFT=16
CONFIG_CGROUPS=y
CONFIG_CGROUP_FREEZER=y
CONFIG_CGROUP_DEVICE=y
CONFIG_CPUSETS=y
# CONFIG_PROC_PID_CPUSET is not set
CONFIG_CGROUP_CPUACCT=y
CONFIG_RESOURCE_COUNTERS=y
CONFIG_MEMCG=y
CONFIG_MEMCG_SWAP=y
CONFIG_CGROUP_SCHED=y
CONFIG_BLK_CGROUP=y
CONFIG_NAMESPACES=y
CONFIG_RELAY=y
CONFIG_BLK_DEV_INITRD=y
CONFIG_RD_BZIP2=y
CONFIG_RD_LZMA=y
CONFIG_RD_XZ=y
CONFIG_RD_LZO=y
CONFIG_RD_LZ4=y
CONFIG_CC_OPTIMIZE_FOR_SIZE=y
CONFIG_EMBEDDED=y
CONFIG_SLAB=y
CONFIG_PROFILING=y
CONFIG_OPROFILE=y
CONFIG_KPROBES=y
CONFIG_MODULES=y
CONFIG_MODULE_UNLOAD=y
CONFIG_MODULE_FORCE_UNLOAD=y
CONFIG_MODVERSIONS=y
CONFIG_BLK_DEV_INTEGRITY=y
CONFIG_CFQ_GROUP_IOSCHED=y
# CONFIG_ARCH_MULTI_V7 is not set
CONFIG_ARCH_MXC=y
CONFIG_MACH_ARMADILLO420=y
# CONFIG_SERIAL_MXC_SELECT1 is not set
CONFIG_PREEMPT=y
CONFIG_AEABI=y
CONFIG_ZBOOT_ROM_TEXT=0x0
CONFIG_ZBOOT_ROM_BSS=0x0
CONFIG_CMDLINE="console=ttymxc1,115200 root=/dev/ram0"
# CONFIG_COREDUMP is not set
CONFIG_NET=y
CONFIG_PACKET=y
CONFIG_UNIX=y
CONFIG_NET_KEY=y
CONFIG_INET=y
CONFIG_IP_MULTICAST=y
CONFIG_IP_PNP=y
CONFIG_IP_PNP_DHCP=y
CONFIG_IP_PNP_BOOTP=y
# CONFIG_INET_XFRM_MODE_TRANSPORT is not set
# CONFIG_INET_XFRM_MODE_TUNNEL is not set
# CONFIG_INET_XFRM_MODE_BEET is not set
# CONFIG_INET_LRO is not set
CONFIG_IPV6=y
CONFIG_INET6_AH=y
CONFIG_INET6_ESP=y
CONFIG_INET6_IPCOMP=y
CONFIG_NETFILTER=y
CONFIG_NF_CONNTRACK=y
CONFIG_NETFILTER_XT_MATCH_CONNTRACK=y
CONFIG_NF_CONNTRACK_IPV4=y
CONFIG_IP_NF_IPTABLES=y
CONFIG_IP_NF_FILTER=y
CONFIG_IP_NF_TARGET_REJECT=y
CONFIG_NF_NAT_IPV4=y
CONFIG_IP_NF_TARGET_MASQUERADE=y
CONFIG_NF_CONNTRACK_IPV6=y
CONFIG_IP6_NF_IPTABLES=y
CONFIG_IP6_NF_FILTER=y
CONFIG_IP6_NF_TARGET_REJECT=y
CONFIG_NF_NAT_IPV6=y
CONFIG_IP6_NF_TARGET_MASQUERADE=y
CONFIG_UEVENT_HELPER_PATH="/sbin/hotplug"
CONFIG_DEVTMPFS=y
CONFIG_DEVTMPFS_MOUNT=y
CONFIG_MTD=y
CONFIG_MTD_CMDLINE_PARTS=y
# CONFIG_MTD_OF_PARTS is not set
CONFIG_MTD_RO_IF=y
CONFIG_MTD_BLOCK=y
CONFIG_MTD_CFI=y
CONFIG_MTD_CFI_INTELEXT=y
CONFIG_MTD_PHYSMAP=y
CONFIG_BLK_DEV_LOOP=y
CONFIG_BLK_DEV_RAM=y
CONFIG_BLK_DEV_RAM_SIZE=65536
CONFIG_SRAM=y
CONFIG_SCSI=y
CONFIG_BLK_DEV_SD=y
# CONFIG_SCSI_LOWLEVEL is not set
CONFIG_NETDEVICES=y
# CONFIG_NET_VENDOR_ARC is not set
# CONFIG_NET_CADENCE is not set
# CONFIG_NET_VENDOR_BROADCOM is not set
# CONFIG_NET_VENDOR_CIRRUS is not set
# CONFIG_NET_VENDOR_FARADAY is not set
# CONFIG_NET_VENDOR_INTEL is not set
# CONFIG_NET_VENDOR_MARVELL is not set
# CONFIG_NET_VENDOR_MICREL is not set
# CONFIG_NET_VENDOR_NATSEMI is not set
# CONFIG_NET_VENDOR_SEEQ is not set
# CONFIG_NET_VENDOR_SMSC is not set
# CONFIG_NET_VENDOR_STMICRO is not set
# CONFIG_NET_VENDOR_VIA is not set
# CONFIG_NET_VENDOR_WIZNET is not set
CONFIG_SMSC_PHY=y
CONFIG_PPP=y
CONFIG_PPP_ASYNC=y
# CONFIG_INPUT_MOUSEDEV is not set
CONFIG_INPUT_EVDEV=y
# CONFIG_KEYBOARD_ATKBD is not set
CONFIG_KEYBOARD_GPIO=y
CONFIG_KEYBOARD_IMX=y
# CONFIG_INPUT_MOUSE is not set
CONFIG_SERIO_LIBPS2=y
CONFIG_DEVPTS_MULTIPLE_INSTANCES=y
CONFIG_SERIAL_IMX=y
CONFIG_SERIAL_IMX_CONSOLE=y
# CONFIG_HW_RANDOM is not set
CONFIG_I2C_CHARDEV=y
CONFIG_I2C_IMX=y
CONFIG_GPIO_SYSFS=y
# CONFIG_HWMON is not set
CONFIG_WATCHDOG=y
CONFIG_IMX2_WDT=y
CONFIG_REGULATOR=y
CONFIG_REGULATOR_FIXED_VOLTAGE=y
CONFIG_MEDIA_SUPPORT=y
CONFIG_MEDIA_CAMERA_SUPPORT=y
CONFIG_MEDIA_USB_SUPPORT=y
CONFIG_USB_VIDEO_CLASS=y
# CONFIG_USB_GSPCA is not set
CONFIG_SOUND=y
CONFIG_SND=y
CONFIG_SND_MIXER_OSS=y
CONFIG_SND_PCM_OSS=y
# CONFIG_SND_ARM is not set
CONFIG_SND_USB_AUDIO=y
CONFIG_SND_USB_CAIAQ=y
CONFIG_SND_USB_CAIAQ_INPUT=y
CONFIG_SND_SOC=y
CONFIG_USB=y
CONFIG_USB_EHCI_HCD=y
CONFIG_USB_STORAGE=y
CONFIG_USB_CHIPIDEA=y
CONFIG_USB_CHIPIDEA_HOST=y
CONFIG_NOP_USB_XCEIV=y
CONFIG_MMC=y
CONFIG_MMC_DELAY_AFTER_SDIO_RESET=y
CONFIG_MMC_SDHCI=y
CONFIG_MMC_SDHCI_PLTFM=y
CONFIG_MMC_SDHCI_ESDHC_IMX=y
CONFIG_MMC_SDHCI_ESDHC_IMX_FORCE_MULTIBLOCK_TRANSFER=y
CONFIG_NEW_LEDS=y
CONFIG_LEDS_CLASS=y
CONFIG_LEDS_GPIO=y
CONFIG_LEDS_TRIGGERS=y
CONFIG_LEDS_TRIGGER_TIMER=y
CONFIG_LEDS_TRIGGER_HEARTBEAT=y
CONFIG_LEDS_TRIGGER_DEFAULT_ON=y
CONFIG_RTC_CLASS=y
CONFIG_RTC_INTF_DEV_UIE_EMUL=y
CONFIG_RTC_DRV_S35390A=y
CONFIG_DMADEVICES=y
# CONFIG_MX3_IPU is not set
CONFIG_IMX_SDMA=y
# CONFIG_IOMMU_SUPPORT is not set
CONFIG_IIO=y
CONFIG_IIO_BUFFER=y
CONFIG_PWM=y
CONFIG_PWM_IMX=y
CONFIG_EXT2_FS=y
CONFIG_EXT2_FS_XATTR=y
CONFIG_EXT2_FS_POSIX_ACL=y
CONFIG_EXT2_FS_SECURITY=y
CONFIG_EXT3_FS=y
CONFIG_EXT3_FS_POSIX_ACL=y
CONFIG_EXT3_FS_SECURITY=y
CONFIG_EXT4_FS=y
CONFIG_EXT4_FS_POSIX_ACL=y
CONFIG_EXT4_FS_SECURITY=y
CONFIG_FANOTIFY=y
CONFIG_QUOTA=y
CONFIG_QUOTA_NETLINK_INTERFACE=y
# CONFIG_PRINT_QUOTA_WARNING is not set
CONFIG_MSDOS_FS=y
CONFIG_VFAT_FS=y
CONFIG_TMPFS=y
CONFIG_TMPFS_POSIX_ACL=y
# CONFIG_NETWORK_FILESYSTEMS is not set
CONFIG_NLS_DEFAULT="utf-8"
CONFIG_NLS_CODEPAGE_437=y
CONFIG_NLS_CODEPAGE_932=y
CONFIG_NLS_ASCII=y
CONFIG_NLS_ISO8859_1=y
CONFIG_NLS_UTF8=y
# CONFIG_SCHED_DEBUG is not set
# CONFIG_DEBUG_PREEMPT is not set
# CONFIG_DEBUG_BUGVERBOSE is not set
# CONFIG_RCU_CPU_STALL_VERBOSE is not set
# CONFIG_FTRACE is not set
# CONFIG_ARM_UNWIND is not set
CONFIG_KEYS=y
CONFIG_CRYPTO_LZO=y
# CONFIG_CRYPTO_ANSI_CPRNG is not set
```
